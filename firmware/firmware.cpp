// The MIT License (MIT)
//
// Copyright (c) 2016 Johannes Frohnhofen
//
// Permission is hereby granted, free of charge, to any person obtaining a copy
// of this software and associated documentation files (the "Software"), to deal
// in the Software without restriction, including without limitation the rights
// to use, copy, modify, merge, publish, distribute, sublicense, and/or sell
// copies of the Software, and to permit persons to whom the Software is
// furnished to do so, subject to the following conditions:
//
// The above copyright notice and this permission notice shall be included in
// all copies or substantial portions of the Software.
//
// THE SOFTWARE IS PROVIDED "AS IS", WITHOUT WARRANTY OF ANY KIND, EXPRESS OR
// IMPLIED, INCLUDING BUT NOT LIMITED TO THE WARRANTIES OF MERCHANTABILITY,
// FITNESS FOR A PARTICULAR PURPOSE AND NONINFRINGEMENT. IN NO EVENT SHALL THE
// AUTHORS OR COPYRIGHT HOLDERS BE LIABLE FOR ANY CLAIM, DAMAGES OR OTHER
// LIABILITY, WHETHER IN AN ACTION OF CONTRACT, TORT OR OTHERWISE, ARISING FROM,
// OUT OF OR IN CONNECTION WITH THE SOFTWARE OR THE USE OR OTHER DEALINGS IN
// THE SOFTWARE.
//
// -----------------------------------------------------------------------------
//

#include <avr/io.h>
#include <avr/interrupt.h>
#include <avr/pgmspace.h>
#include <util/delay.h>

#define MIDI_BAUD_RATE     31250

#define MIDI_A0            0x15
#define MIDI_NOTE_ON       0x90
#define MIDI_NOTE_OFF      0x80
#define MIDI_CONTROL       0xb0
#define MIDI_PROGRAM       0xc0
#define MIDI_SUSTAIN_PEDAL 0x40
#define MIDI_SOFT_PEDAL    0x43

#define SUSTAIN_PEDAL      PD3
#define SOFT_PEDAL         PD4

#define for_set_bits(BIT, VAR) \
  for(uint8_t BIT=0; VAR>0; BIT++, VAR>>=1) \
    if(VAR & 1)

#define min(a, b) ((a) < (b) ? (a) : (b))

#define KEY_INDEX(CHANNEL, LINE) (((LINE) >> 3) * 0x28 + ((CHANNEL) << 3) + ((LINE) & 0b111))

#define MIDI_KEY(CHANNEL, LINE) (MIDI_A0 + KEY_INDEX(CHANNEL, LINE))

#define READ_LINES(CHANNEL, VAR) \
  PORTB = channel_addr[(CHANNEL)]; \
  _delay_us(30); \
  VAR = (PINC << 8) | PINA;

#define HANDLE_PEDAL(PIN, COMMAND) \
  if(pedals & _BV(PIN)) { \
    uart_putc(MIDI_CONTROL); \
    uart_putc(COMMAND); \
    uart_putc((stateP & _BV(PIN)) << (6 - (PIN))); \
    _delay_ms(2); \
  }

const uint8_t channel_addr[] = {
  0b0000, 0b1000, 0b0100, 0b1100, 0b0010, 0b1010,
  0b0110, 0b1110, 0b0001, 0b1001, 0b0101, 0b1101
};

const uint8_t velocities[] PROGMEM = {
  0x7f, 0x7f, 0x7f, 0x7f, 0x7f, 0x7f, 0x7f, 0x7f, 0x7f, 0x7f, 0x7f, 0x7f, 0x7f, 0x7f, 0x7f, 0x7f,
  0x7f, 0x7f, 0x7f, 0x7f, 0x7f, 0x7f, 0x7f, 0x7f, 0x7f, 0x7f, 0x7f, 0x7f, 0x7f, 0x7f, 0x7f, 0x7e,
  0x7d, 0x7b, 0x7a, 0x78, 0x77, 0x75, 0x74, 0x73, 0x72, 0x71, 0x70, 0x6f, 0x6e, 0x6d, 0x6c, 0x6b,
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  0x37, 0x37, 0x37, 0x37, 0x37, 0x37, 0x37, 0x37, 0x37, 0x37, 0x36, 0x36, 0x36, 0x36, 0x36, 0x36,
  0x36, 0x36, 0x36, 0x36, 0x36, 0x35, 0x35, 0x35, 0x35, 0x35, 0x35, 0x35,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 0x25,
  0x25, 0x25, 0x25, 0x25, 0x25, 0x25, 0x25, 0x25, 0x25, 0x25, 0x25, 0x25,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 0x12, 0x12};

inline void uart_init()
{
  uint16_t baud = (((F_CPU) + 8UL * (MIDI_BAUD_RATE)) / (16UL * (MIDI_BAUD_RATE)) - 1UL);

  UBRRH = baud >> 8;
  UBRRL = baud;
  UCSRB = _BV(RXEN) | _BV(TXEN);
}

inline void uart_putc(uint8_t byte)
{
  while(!(UCSRA & _BV(UDRE)));
  UDR = byte;
}

inline void midi_note_on(uint8_t note, uint8_t velocity)
{
  uart_putc(MIDI_NOTE_ON);
  uart_putc(note);
  uart_putc(velocity);
}

inline void midi_note_off(uint8_t note)
{
  midi_note_on(note, 0x00);
}

inline void midi_program(uint8_t program)
{
  uart_putc(MIDI_PROGRAM);
  uart_putc(program);
}

int main()
{
  uint16_t stateA[6], stateB[6];
  uint16_t inputA, inputB;
  uint16_t timer, note_on, note_off;
  uint16_t timestamp;
  uint16_t timers[96];

  uint8_t stateP;
  uint8_t inputP;
  uint8_t pedals;

  // set PORTA and PORTC as input with pullup
  DDRA  = 0x00;
  PORTA = 0xff;
  DDRC  = 0x00;
  PORTC = 0xff;

  // set PORTB0-3 as output
  DDRB = 0x0f;

  DDRD  = _BV(PD5);
  PORTD = _BV(PD3) | _BV(PD4);

  // set timer1 pre-scaler to 1024
  TCCR1B = (1 << CS12) | (1 << CS10);

  uart_init();

  for(;;) {

    for(uint8_t chan = 0; chan < 6; chan++) {

      READ_LINES(chan << 1, inputA);
      READ_LINES((chan << 1) + 1, inputB);

      // time measurements
      timer = (stateA[chan] ^ ~stateB[chan]) & (inputA ^ inputB | stateA[chan] ^ inputA);
      timestamp = TCNT1;

      for_set_bits(line, timer) {
        timers[KEY_INDEX(chan, line)] = timestamp;
      }

      // output notes
      note_on = stateB[chan] & ~inputA & ~inputB;
      note_off = ~stateB[chan] & inputA & inputB;

      for_set_bits(line, note_on) {
        uint16_t touch_duration = timestamp - timers[KEY_INDEX(chan, line)];
        touch_duration = min(touch_duration, sizeof(velocities) - 1);
        uint8_t velocity = pgm_read_byte(&(velocities[touch_duration]));
        midi_note_on(MIDI_KEY(chan, line), 100);
      }

      for_set_bits(line, note_off) {
        midi_note_off(MIDI_KEY(chan, line));
      }

      // update states
      stateA[chan] = inputB | (~stateB[chan] & inputA);
      stateB[chan] = stateA[chan] ^ inputA ^ inputB;
    }

    inputP = PIND;
    pedals = inputP ^ stateP;

    HANDLE_PEDAL(SUSTAIN_PEDAL, MIDI_SUSTAIN_PEDAL)
    HANDLE_PEDAL(SOFT_PEDAL, MIDI_SOFT_PEDAL)

    stateP = inputP;
  }
}
